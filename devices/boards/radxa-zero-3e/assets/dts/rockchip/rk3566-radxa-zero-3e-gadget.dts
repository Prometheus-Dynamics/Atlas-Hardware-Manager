// REMOVE when Gaia's generator step lands (PR B16): Lemnos's generated overlay (lemnos-ctl tree) is merged
// into the board's dtb by Gaia with fdtoverlay, and this hand-written gadget DTS is replaced by that overlay.
// Kept until then: the bring-up's gadget port depends on it.
// SPDX-License-Identifier: (GPL-2.0+ OR MIT)
// The ZERO 3E with its USB 2.0 OTG port (usb_host0_xhci) as a USB device, so
// the gadget can be a network function. Carried from dev's gadget DTS.
// Why this DTS, and not the in-tree one: a gadget needs the port in peripheral
// mode; this file changes only that property. (Whether the in-tree DTS leaves it
// in host mode is not checked here.)
// B31: this file also carries the reboot-mode node (the no-button way back to the loader, under &pmugrf at offset
// 0x200: U-Boot's ROCKCHIP_BOOT_MODE_REG for RK3568 is 0xfdc20200, arch/arm/mach-rockchip/rk3568/Kconfig:70-71, and pmugrf
// is 0xfdc20000, rk356x-base.dtsi:367). The reboot-mode node MUST move with this file when it is removed (into the
// generated overlay or the replacement board dts). Untested on board.
#include "rk3566-radxa-zero-3e.dts"
#include <dt-bindings/soc/rockchip,boot-mode.h>

&usb_host0_xhci {
	dr_mode = "peripheral";
};

&pmugrf {
	reboot-mode {
		compatible = "syscon-reboot-mode";
		offset = <0x200>;
		mode-normal = <BOOT_NORMAL>;
		mode-loader = <0xef08a53c>;
		mode-recovery = <BOOT_RECOVERY>;
		mode-bootloader = <BOOT_FASTBOOT>;
	};
};
