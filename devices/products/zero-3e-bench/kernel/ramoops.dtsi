// Radxa ZERO 3E bench: the crash log kept across a reset (pstore, ramoops). STANDALONE, NOT WIRED: Gaia's board and
// family files are the place to attach it (see docs/prs/Z1.md).
//
// Address: 0x110000, size 0xf0000, as the mainline RK3566 precedent gives it: rk3566-lckfb-tspi.dts, lines 32-38, at Linux
// v7.3.4 (kernel tree 7552930, cached on this machine). It sits below U-Boot's load windows (kernel_addr_r 0x02000000, cited by the coordinator and not read here,
// include/configs/rk3568_common.h:27), so the kernel and the DTB load above it and nothing overwrites the log. The pmsg, ftrace and ECC
// areas are 0: the crash log is the console record, nothing else.
// Sizes: console 0x20000 (128 KiB), record 0x10000 (64 KiB); the region holds both (0x30000 of 0xf0000).
// Not checked against this board's memory map beyond that: a board read of /proc/iomem is still to do.
/ {
	reserved-memory {
		#address-cells = <2>;
		#size-cells = <2>;
		ranges;

		ramoops: ramoops@110000 {
			compatible = "ramoops";
			reg = <0x0 0x110000 0x0 0xf0000>;
			console-size = <0x20000>;
			record-size = <0x10000>;
			ftrace-size = <0>;
			pmsg-size = <0>;
			ecc-size = <0>;
		};
	};
};
