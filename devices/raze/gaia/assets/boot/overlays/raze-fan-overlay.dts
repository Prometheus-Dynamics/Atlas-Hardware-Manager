// SPDX-License-Identifier: GPL-2.0-only
/*
 * Raze: CM5 fan on RP1 PWM1 channel 3, driven by the kernel thermal governor
 * (pwm-fan + the CM5 cpu thermal trips). No userspace daemon is needed.
 *
 * Load:   dtoverlay=raze-fan[,<param>=<val>][,notach]
 *
 * Replaces the old helios-fan-overlays.sh, which wrote four base64 .dtbo blobs
 * into configfs at runtime and hard-coded the RP1 PWM phandle (0x62). Values
 * recovered from those blobs with `dtc -I dtb -O dts`:
 *   /cooling_fan            status = "okay"
 *   /cooling_fan            cooling-levels = <0xe0 0xf0 0xf8 0xff 0xff>
 *   /axi/pcie@1000120000/rp1/pwm@9c000   status = "okay"
 *   /cooling_fan            pwms = <0x62 0x03 0xa25e 0x00>
 *                           (rp1_pwm1, channel 3, 41566 ns, flags 0)
 *
 * Polarity: normal (flags 0). Package 1.0.7 and earlier inverted it
 * (PWM_POLARITY_INVERTED, as the CM5 base device tree does), but on a Raze
 * Gen 1 that left the fan "basically not moving": the 88 % low level came out
 * near 12 %, and the 100 % top level would have stopped the fan when the board
 * was hottest. The old helios setup inverted twice (overlay normal, daemon
 * invert_pwm), which also comes out normal. Use polarity=1 for a revision
 * that really drives the fan inverted.
 *
 * Levels: index 0 is the duty below the first trip (cpu-tepid, 50 C), then one
 * per trip (60, 67.5, 75 C): 179/255 = 70 % minimum (always moving air), 212 =
 * 83 %, 245 = 96 %, then 100 %. The trip temperatures are the base DT's and can
 * be tuned with the base dtparams fan_temp0..3 (put them before any
 * dtoverlay= line).
 *
 * Tachometer: pwm-fan reads the speed from the RP1 PWM's pulse counter
 * (rpm-regmap, from the base DT) as hwmon fan1_input. notach enables a
 * fragment that sets rpm-regmap to 0 (a literal, not a phandle the firmware
 * would resolve), so pwm-fan finds no counter and offers no speed: for a
 * revision whose tach line isn't wired (Gen 1, where it reads 0 rpm while
 * the fan spins).
 */
/dts-v1/;
/plugin/;

/ {
	compatible = "brcm,bcm2712";

	fragment@0 {
		target = <&rp1_pwm1>;
		__overlay__ {
			status = "okay";
		};
	};

	fragment@1 {
		target = <&fan>;
		fan_props: __overlay__ {
			status = "okay";
			/* >>> gen-raze: fan (generated from manifest.json by devices/tools/gen-raze.py; do not edit) */
			cooling-levels = <179 212 245 255 255>;
			/* rp1_pwm1 channel 3, 41566 ns, normal polarity */
			pwms = <&rp1_pwm1 3 41566 0>;
			/* <<< gen-raze */
		};
	};

	fragment@2 {
		target = <&fan>;
		__dormant__ {
			rpm-regmap = <0>;
		};
	};

	__overrides__ {
		level0 = <&fan_props>, "cooling-levels:0";
		level1 = <&fan_props>, "cooling-levels:4";
		level2 = <&fan_props>, "cooling-levels:8";
		level3 = <&fan_props>, "cooling-levels:12";
		level4 = <&fan_props>, "cooling-levels:16";
		period_ns = <&fan_props>, "pwms:8";
		polarity = <&fan_props>, "pwms:12";
		notach = <0>, "+2";
	};
};
