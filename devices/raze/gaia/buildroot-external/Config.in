## devices/raze/gaia/buildroot-external/packages/board-agent/Config.in
```kconfig
config BR2_PACKAGE_BOARD_AGENT
	bool "board-agent"
	depends on BR2_PACKAGE_HOST_RUSTC_TARGET_ARCH_SUPPORTS
	select BR2_PACKAGE_HOST_RUSTC
	help
	  The board's Orion device agent: connects to orion-node's local
	  IPC, claims the node actions update, update.cancel,
	  update.rollback, reboot and locate, runs them with the device
	  package's writer (/usr/lib/board/update), and publishes the
	  writer's state as the update.* status keys. Without orion-node
	  it waits; nothing on the board depends on it.

	  Source: crates/board-agent in the Atlas repository this device
	  package belongs to (built from that checkout, see
	  board-agent.mk).
```

## devices/raze/gaia/buildroot-external/packages/board-image-slots/Config.in
```kconfig
config BR2_PACKAGE_BOARD_IMAGE_SLOTS
	bool "board-image-slots"
	help
	  Copies one slot's boot and root partitions out of a whole disk
	  image streamed on stdin, without seeking. The device package's
	  A/B updater (/usr/lib/board/update) uses it to install the
	  same .img.xz that is flashed over USB into the inactive slot.

	  Source: src/board-image-slots.c in this package.
```

## devices/raze/gaia/buildroot-external/packages/pd-image-slots/Config.in
```kconfig
config BR2_PACKAGE_PD_IMAGE_SLOTS
	bool "pd-image-slots"
	help
	  Copies one slot's boot and root partitions out of a whole disk
	  image streamed on stdin, without seeking. The device package's
	  A/B updater (/usr/lib/pd-device/update) uses it to install the
	  same .img.xz that is flashed over USB into the inactive slot.

	  Source: src/pd-image-slots.c in this package.
```

## devices/raze/gaia/buildroot-external/packages/rpi-utils/Config.in
```kconfig
config BR2_PACKAGE_RPI_UTILS
	bool "rpi-utils (vcgencmd, vcmailbox)"
	depends on BR2_arm || BR2_aarch64
	help
	  vcgencmd from Raspberry Pi's utils repository: queries the
	  VideoCore firmware through /dev/vcio (bootloader version,
	  clocks, temperatures, throttling).

	  vcmailbox sends raw firmware mailbox requests; the device
	  package uses it for a one-time reboot into USB boot.

	  Buildroot 2026.08 removed rpi-userland, which used to provide
	  both. Only these two tools are built from this repository.

	  https://github.com/raspberrypi/utils
```
